#include <Arduino.h>
#include <esp_camera.h>
#include "board.h"
#include "app.h"

static bool s_ready = false;

bool cameraBegin(void) {
  if (!psramFound()) {
    Serial.println("camera: refusing to init — no PSRAM (see the board report)");
    return false;
  }

  camera_config_t cfg = {};
  cfg.ledc_channel = LEDC_CHANNEL_0;   /* XCLK is generated by LEDC. Do not */
  cfg.ledc_timer   = LEDC_TIMER_0;     /* analogWrite() on this channel.    */

  cfg.pin_pwdn     = BOARD_CAM_PWDN;
  cfg.pin_reset    = BOARD_CAM_RESET;
  cfg.pin_xclk     = BOARD_CAM_XCLK;
  cfg.pin_sccb_sda = BOARD_CAM_SIOD;
  cfg.pin_sccb_scl = BOARD_CAM_SIOC;
  cfg.pin_d0 = BOARD_CAM_D0;  cfg.pin_d1 = BOARD_CAM_D1;
  cfg.pin_d2 = BOARD_CAM_D2;  cfg.pin_d3 = BOARD_CAM_D3;
  cfg.pin_d4 = BOARD_CAM_D4;  cfg.pin_d5 = BOARD_CAM_D5;
  cfg.pin_d6 = BOARD_CAM_D6;  cfg.pin_d7 = BOARD_CAM_D7;
  cfg.pin_vsync = BOARD_CAM_VSYNC;
  cfg.pin_href  = BOARD_CAM_HREF;
  cfg.pin_pclk  = BOARD_CAM_PCLK;

  /* 20 MHz is the usual number and works on most batches; 10 MHz is what the
   * board vendor ships and is the first thing to try when frames come back
   * torn, green, or not at all. */
  cfg.xclk_freq_hz = 20000000;
  cfg.pixel_format = PIXFORMAT_JPEG;
  cfg.frame_size   = FRAMESIZE_SVGA;
  cfg.jpeg_quality = 12;               /* lower = better = more PSRAM */
  cfg.fb_count     = 2;                /* >1 needs PSRAM and enables double buffering */
  cfg.fb_location  = CAMERA_FB_IN_PSRAM;
  cfg.grab_mode    = CAMERA_GRAB_LATEST;

  esp_err_t err = esp_camera_init(&cfg);
  if (err != ESP_OK) {
    Serial.printf("camera: esp_camera_init failed: 0x%x (%s)\n", err, esp_err_to_name(err));
    switch (err) {
      case ESP_ERR_NOT_FOUND:
        Serial.println("        no sensor answered on SCCB. Reseat the FPC — contacts");
        Serial.println("        face the PCB — and check the module is not an OV5640.");
        break;
      case ESP_ERR_NO_MEM:
        Serial.println("        frame buffer allocation failed. Drop frame_size or fb_count.");
        break;
      default:
        break;
    }
    return false;
  }

  sensor_t *s = esp_camera_sensor_get();
  if (s) {
    /* This board mounts the sensor upside down relative to the silkscreen. */
    s->set_vflip(s, 1);
    s->set_hmirror(s, 1);
    s->set_brightness(s, 1);
  }
  s_ready = true;
  return true;
}

void cameraReport(void) {
  if (!s_ready) { Serial.println("camera      : not initialised"); return; }
  sensor_t *s = esp_camera_sensor_get();
  Serial.printf("camera      : sensor PID 0x%04x", s ? s->id.PID : 0);
  if (s) {
    switch (s->id.PID) {
      case OV2640_PID: Serial.print(" (OV2640)"); break;
      case OV3660_PID: Serial.print(" (OV3660)"); break;
      case OV5640_PID: Serial.print(" (OV5640)"); break;
      case GC2145_PID: Serial.print(" (GC2145)"); break;
      case GC0308_PID: Serial.print(" (GC0308)"); break;
      default: break;
    }
  }
  Serial.println();
}

bool cameraCaptureToSd(const char *dir) {
  if (!s_ready) return false;

  camera_fb_t *fb = esp_camera_fb_get();
  if (!fb) { Serial.println("camera: capture returned NULL"); return false; }

  bool ok = false;
  if (fb->format == PIXFORMAT_JPEG) {
    char path[64];
    snprintf(path, sizeof(path), "%s/%d.jpg", dir, sdNextIndex(dir));
    ok = sdWriteBlob(path, fb->buf, fb->len);
    if (ok) Serial.printf("camera: %s, %u bytes, %ux%u\n",
                          path, (unsigned)fb->len, fb->width, fb->height);
  } else {
    Serial.println("camera: frame is not JPEG — use frame2jpg() first");
  }

  /* Every fb_get() must be matched by an fb_return(), including on the error
   * paths. Two missed returns with fb_count=2 and the driver stalls forever. */
  esp_camera_fb_return(fb);
  return ok;
}
